## config/boards/shields/dumbpad/Kconfig.defconfig
```kconfig
# Copyright (c) 2020 The ZMK Contributors
# SPDX-License-Identifier: MIT

if SHIELD_DUMBPAD

config ZMK_KEYBOARD_NAME
    default "dumbpad"

config ZMK_BEHAVIOR_ENCODER
    bool "Enable encoder support"
    default y


endif

endif #SHIELD_DUMBPAD
```

## config/boards/shields/dumbpad/Kconfig.shield
```kconfig
# Copyright (c) 2020 The ZMK Contributors
# SPDX-License-Identifier: MIT

config SHIELD_DUMBPAD
    def_bool $(shields_list_contains,dumbpad)
```
